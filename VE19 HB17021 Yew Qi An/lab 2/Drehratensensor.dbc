VERSION ""

NS_ :

BS_:

BU_:

BO_ 3221225472 VECTOR__INDEPENDENT_SIG_MSG: 0 Vector__XXX
 SG_ QuerbeschleunigungX : 0|16@1+ (0.000127465,-4.1768) [-4.1768|4.176618775] "g" Vector__XXX
 SG_ QuerbeschleunigungY : 0|16@1+ (0.000127465,-4.1768) [-4.1768|4.176618775] "g" Vector__XXX

BO_ 512 Drehratennachricht2: 2 Vector__XXX
 SG_ Drehbeschleunigung : 0|16@1+ (0.125,-4096) [-4096|4095.875] "?/s2 " Vector__XXX

BO_ 256 Drehratennachricht1: 2 Vector__XXX
 SG_ Drehgeschwindigkeit : 0|16@1+ (0.005,-163.84) [-163.84|163.835] "бу/s" Vector__XXX

CM_ BO_ 3221225472 "This is a message for not used signals, created by Vector CANdb++ DBC OLE DB Provider.";
BA_DEF_  "BusType" STRING ;
BA_DEF_DEF_  "BusType" "CAN";
