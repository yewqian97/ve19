VERSION ""

NS_ :

BS_:

BU_: Kombiinstrument

BO_ 515 Wheel_rpm: 4 Vector__XXX
 SG_ Wheel_rpm_vr : 23|14@0+ (1,0) [0|0] "" Vector__XXX
 SG_ Wheel_rpm_vl : 7|14@0+ (1,0) [0|0] "" Vector__XXX

BO_ 1 Klemmenstatus: 1 Kombiinstrument
 SG_ Klemmeninformation : 0|8@1+ (1,0) [0|0] "" Vector__XXX

EV_ EnvKlemme15: 0 [0|1] "" 0 1 DUMMY_NODE_VECTOR0 Vector__XXX;

BA_DEF_ BU_  "NodeLayerModules" STRING ;
BA_DEF_ BO_  "GenMsgILSupport" ENUM  "No","Yes";
BA_DEF_ BU_  "NmStationAddress" INT 0 63;
BA_DEF_  "NmBaseAddress" HEX 1024 1087;
BA_DEF_  "BusType" STRING ;
BA_DEF_ BO_  "GenMsgSendType" ENUM  "Cyclic","NotUsed","NotUsed","NotUsed","NotUsed","Cyclic","NotUsed","IfActive","NoMsgSendType","NotUsed","vector_leerstring";
BA_DEF_ SG_  "GenSigSendType" ENUM  "Cyclic","OnWrite","OnWriteWithRepetition","OnChange","OnChangeWithRepetition","IfActive","IfActiveWithRepetition","NoSigSendType","NotUsed","NotUsed","NotUsed","NotUsed","NotUsed";
BA_DEF_DEF_  "NodeLayerModules" "CANoeILNLVector.dll";
BA_DEF_DEF_  "GenMsgILSupport" "Yes";
BA_DEF_DEF_  "NmStationAddress" 0;
BA_DEF_DEF_  "NmBaseAddress" 1024;
BA_DEF_DEF_  "BusType" "CAN";
BA_DEF_DEF_  "GenMsgSendType" "NoMsgSendType";
BA_DEF_DEF_  "GenSigSendType" "Cyclic";
BA_ "NmStationAddress" BU_ Kombiinstrument 1;
BA_ "GenMsgSendType" BO_ 515 0;
BA_ "GenMsgSendType" BO_ 1 0;
